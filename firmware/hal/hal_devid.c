/***************************************************************************************************
 *                                             INCLUDES
 ***************************************************************************************************/
#include "hal_devid.h"
#include "M051Series.h"
/***************************************************************************************************
 *                                              CONSTANTS
 ***************************************************************************************************/
#define UID_SIZE    3
#define CID_SIZE    1
#define PID_SIZE    1


/***************************************************************************************************
 *                                              TYPEDEFS
 ***************************************************************************************************/


/***************************************************************************************************
 *                                           GLOBAL VARIABLES
 ***************************************************************************************************/
static uint32_t uid[UID_SIZE];
static uint32_t cid[CID_SIZE];
static uint32_t pid[PID_SIZE];

/***************************************************************************************************
 *                                            LOCAL FUNCTION
 ***************************************************************************************************/

 
/***************************************************************************************************
 *                                            FUNCTIONS - API
 ***************************************************************************************************/

/***************************************************************************************************
 * @fn      HalDevIdInit
 *
 * @brief   Initialize DevId Service
 *
 * @param   None
 *
 * @return  None
 ***************************************************************************************************/
void HalDevIdInit (void)
{
    uint8_t i;

    SYS_UnlockReg();
    FMC_Open();
    
    //Company ID
    for(i = 0; i < CID_SIZE; i++)
    {
        cid[i] = FMC_ReadCID();
    }

    //Product ID
    for(i = 0; i < PID_SIZE; i++)
    {
        pid[i] = FMC_ReadPID();
    }

    //Unique ID
    for(i = 0; i < UID_SIZE; i++)
    {
        uid[i] = FMC_ReadUID(i);
    }
    FMC_Close();
    SYS_LockReg();
}

extern uint32_t HalDevIdRead (uint8_t index)
{
    //Company ID
    if(index < CID_SIZE)
        return cid[index];
    index -= CID_SIZE;
    
    //Product ID
    if(index < PID_SIZE)
        return pid[index];
    index -= PID_SIZE;
    
    //Unique ID
    if(index < UID_SIZE)
        return uid[index];

    return 0;
}

/***************************************************************************************************
***************************************************************************************************/




